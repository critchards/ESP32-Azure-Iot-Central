#include <Arduino.h>

/**
 * 20210713
 * Chris Richards
 *
 * This program should allow a generic ESP32 with a DHT11 sensor to connect to Azure Iot Central via MQTT and send
 * temperature and humidity telemetry. Azure IoT Central can be used to toggle the onboard LED on the ESP32 Devboard as well
 * as write messages to the serial monitor via commands.
 *
 * Wifi settings and the specific connection string for your Azure IoT Central app should be added to the iot_configs.h file. Note
 * the connection string is generated by provisioning your device. The getting started tutorial suggests using Azure IoT Device Workbench
 * to handle all the Azure IoT Hub setup and device provisioning but it didnt work for me. I had to use a stand alone tool to create
 * the connection string from the user supplied scope-id, device-id and primary-key using the dps-keygen tool found here
 * https://github.com/Azure/dps-keygen.
 * Details on how to provision with different approaches are found here,
 * https://github.com/Azure/azure-iot-device-ecosystem/blob/master/setup_iothub.md#create-new-device-in-the-iot-hub-device-identity-registry
 *
 * platformio.ini was modified to include necsssary libraries and build flags. Thank you to https://github.com/maxgerhardt/pio-azure-iot-arduino-demo
 * for providing details
 *
 * This code was originally taken from https://github.com/lzyms/ESP32IoTCentral, and appears to be in alignment with the current
 * getting started guide for ESP32 on Azure Samples at https://github.com/Azure-Samples/esp32-iot-devkit-get-started
 * Many changes were made
 */

//unlike Arduino IDE, platformio in VScode requires all referenced libraries to be called out 
#include <WiFi.h>
#include <Esp32MQTTClient.h>
#include <WiFiClientSecure.h>
#include "Adafruit_Sensor.h"    //requried for DHT sensor
#include "DHT.h"                //for DHT sensor
#include "iot_configs.h"      //this file holds wifi credentials and the Azure IoT Hub connection string

#define INTERVAL 10000        //time between messages sent to Azure IoT Hub
#define MESSAGE_MAX_LEN 256   //changes the maximum size of the message that can be sent

DHT dht(19,DHT11);    //create an instance of the DHT11 sensor conneted to pin 19

//Credentials taken from configs.h
const char* ssid     = IOT_CONFIG_WIFI_SSID;
const char* password = IOT_CONFIG_WIFI_PASSWORD;
static const char* connectionString = DEVICE_CONNECTION_STRING;

const char *messageData = "{\"messageId\":%d, \"temperature\":%f, \"humidity\":%f, \"LED\":%i}";  //Structure of the message sent to Azure IoT Hub
static bool hasIoTHub = false;
static bool hasWifi = false;
int messageCount = 1;
static bool messageSending = true;
static uint64_t send_interval_ms;
boolean LED = false;                //for toggling the built in LED on and off

//this function will run when Azure IoT confirms it has recieved a message from the device
static void SendConfirmationCallback(IOTHUB_CLIENT_CONFIRMATION_RESULT result)
{
  if (result == IOTHUB_CLIENT_CONFIRMATION_OK)
  {
    Serial.println("Send Confirmation Callback finished.");
  }
}

//this function will run when Azure confirms it has sent a message to the device
static void MessageCallback(const char* payLoad, int size)
{
  Serial.println("Message callback:");
  Serial.println(payLoad);
}

//will run when device twin activity performed
static void DeviceTwinCallback(DEVICE_TWIN_UPDATE_STATE updateState, const unsigned char *payLoad, int size)
{
  char *temp = (char *)malloc(size + 1);
  if (temp == NULL)
  {
    return;
  }
  memcpy(temp, payLoad, size);
  temp[size] = '\0';
  // Display Twin message.
  Serial.println("Device twin callback active");
  Serial.println(temp);
  free(temp);
}

//will run when a message is recieved on the device from Azure IoT Hub. This is where we can make our device react to input from the Cloud.
static int  DeviceMethodCallback(const char *methodName, const unsigned char *payload, int size, unsigned char **response, int *response_size)
{
  LogInfo("Try to invoke method %s", methodName);                           //methodName is the Name* of the command sent from IoT Central.
  const char *responseMessage = "\"Successfully invoke device method\"";    //must be a properlly formatted JSON message. Azure IoT used this to confirm message received
  int result = 200;                                                         //200 is good, 400 is bad. https://docs.microsoft.com/en-us/azure/iot-hub/iot-hub-mqtt-support

  //we can check the methodName for known commands and react when they match
  
  if (strcmp(methodName, "start") == 0)     //looking for a message coming in under the command named start
  {
    LogInfo("Start sending temperature and humidity data");
    messageSending = true;
  }
  else if (strcmp(methodName, "stop") == 0)   //looking for a message coming in under the command named stop
  {
    LogInfo("Stop sending temperature and humidity data");
    messageSending = false;
  }
  else if (strcmp(methodName, "echo") == 0)   //looking for a message coming in under the command named echo
  {
    Serial.println("echo command detected");
    Serial.print("Executed direct method payload: ");
    Serial.println((const char *)payload);

  }
  else if (strcmp(methodName, "toggleLED") == 0)   //looking for a message coming in under the command named ledON
  {
    Serial.println("toggle the LED");
    LED = !LED;
    digitalWrite(2, LED);
  }
  else
  {
    LogInfo("No method %s found", methodName);    //if a message comes in from an unrecognized command, go here
    responseMessage = "\"No method found\"";
    result = 404;
  }

  *response_size = strlen(responseMessage);       //originally had a +1 on it, messed up the JSON, made Azure IoT angry
  *response = (unsigned char *)strdup(responseMessage);

  return result;                                  //return the status code
}

//turn all the things on
void setup() {
  Serial.begin(115200);
  dht.begin();
  pinMode(2, OUTPUT);
  digitalWrite(2, HIGH);
  Serial.println("ESP32 Device");
  Serial.println("Initializing...");
  Serial.println(" > WiFi");
  Serial.println("Starting connecting WiFi.");

  //initialize the wifi connection using the credentials fron iot_config.h
  delay(10);
  WiFi.mode(WIFI_AP);
  WiFi.begin(ssid, password);
  while (WiFi.status() != WL_CONNECTED) {
    delay(500);
    Serial.print(".");
    hasWifi = false;
  }
  hasWifi = true;
  Serial.println("WiFi connected");
  Serial.println("IP address: ");
  Serial.println(WiFi.localIP());
  Serial.println(" > IoT Hub");
  
  //connect to IoT Hub using the connection string from iot_config.h
  if (!Esp32MQTTClient_Init((const uint8_t*)connectionString, true))
  {
    hasIoTHub = false;
    Serial.println("Initializing IoT hub failed.");
    return;
  }
  hasIoTHub = true;

  //set up all the callback functions, all the subscriptions are handled in ESP32MQTTCLIENT
  Esp32MQTTClient_SetSendConfirmationCallback(SendConfirmationCallback);
  Esp32MQTTClient_SetMessageCallback(MessageCallback);
  Esp32MQTTClient_SetDeviceTwinCallback(DeviceTwinCallback);
  Esp32MQTTClient_SetDeviceMethodCallback(DeviceMethodCallback);
  Serial.println("Start sending events.");
  send_interval_ms = millis();              //state machine timer for sending telemetry
  digitalWrite(2, LOW);                     //turn off the onboard LED, debugging
}

void loop() {
if (hasWifi && hasIoTHub)
  {
    if (messageSending && (int)(millis() - send_interval_ms) >= INTERVAL)
    {  
      char messagePayload[MESSAGE_MAX_LEN];         //create an array of characters to hold the message that will be sent to Azure IoT Hub
      float temperature = dht.readTemperature();    //collect the temperature and humidity from the dht11 sensor
      float humidity = dht.readHumidity();
      snprintf(messagePayload, MESSAGE_MAX_LEN, messageData, messageCount++, temperature, humidity, LED); //build the message from the function data and the measurements defined at the top (temp, humidity, led)
      Serial.println(messagePayload);                                                                     //write the message to the serial monitor for debugging
      EVENT_INSTANCE* message = Esp32MQTTClient_Event_Generate(messagePayload, MESSAGE);                  //get ready to send a message to the MQTT broker
      Esp32MQTTClient_SendEventInstance(message);                                                         //send the message
      send_interval_ms = millis();                                                                        //update the state machine timer
    }
    else
    {
      Esp32MQTTClient_Check();                                                                            //keep the connection to Auzre IoT Hub alive even when not sending messages
    }
  }
  delay(10);
}